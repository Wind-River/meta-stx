## conf/distro/poky-stx.conf
```bitbake
require conf/distro/poky.conf
DISTRO = "poky-stx"
DISTRO_NAME = "Stx (Poky Starlingx Distro)"
DISTRO_VERSION = "2.7.3"
DISTRO_CODENAME = "warrior"

MAINTAINER = "zbsarashki <zbsarashki@gmail.com>"

require conf/distro/include/stx-features.inc
require conf/distro/include/stx-preferred-vers.inc

# For packagegroup-basic
TASK_BASIC_SSHDAEMON = "openssh-sshd openssh-sftp openssh-sftp-server"

# For iso image
#KERNEL_FEATURES += "features/overlayfs/overlayfs.scc"


# Disable services by default
SYSTEMD_AUTO_ENABLE_pn-haproxy = "disable"
SYSTEMD_AUTO_ENABLE_pn-lighttpd = "disable"

# /var/log is mounted as a logical volume for stx,
# so do not link to /var/volatile/log.
VOLATILE_LOG_DIR = "no"

# We don't need extra space for iso image
IMAGE_OVERHEAD_FACTOR = "1.05"
```

## conf/distro/stx.conf
```bitbake
#
# Copyright (C) 2019 Wind River Systems, Inc.
#
#  Licensed under the Apache License, Version 2.0 (the "License");
#  you may not use this file except in compliance with the License.
#  You may obtain a copy of the License at
#
#      http://www.apache.org/licenses/LICENSE-2.0
#
#  Unless required by applicable law or agreed to in writing, software
#  distributed under the License is distributed on an "AS IS" BASIS,
#  WITHOUT WARRANTIES OR CONDITIONS OF ANY KIND, either express or implied.
#  See the License for the specific language governing permissions and
#  limitations under the License.

#@TYPE: Distro
#@NAME: Akraino
#@DESCRIPTION: StarlingX Distribution


DISTRO_FEATURES_NATIVE_append += "systemd ima tpm tpm2 efi-secure-boot luks"
DISTRO_FEATURES_append += "systemd ima tpm tpm2 efi-secure-boot luks"
MACHINE_FEATURES_NATIVE_append += "efi"
MACHINE_FEATURES_append += "efi"

# For iso image
KERNEL_FEATURES += "features/overlayfs/overlayfs.scc"

INITRAMFS_SCRIPTS = "initramfs-live-boot \
                     initramfs-live-install \
		     initramfs-live-install-efi \
		     "


VIRTUAL-RUNTIME_init_manager = "systemd"
DISTRO_FEATURES_append = " systemd"
DISTRO_FEATURES_BACKFILL_CONSIDERED += "sysvinit"

DISTRO_FEATURES_append = " bluez pam largefile opengl"
DISTRO_FEATURES_append = " virtualization"
DISTRO_FEATURES_append = " openstack"
DISTRO_FEATURES_append = " selinux"
DISTRO_FEATURES_append = " kvm"

PREFERRED_PROVIDER_virtual/containerd = "containerd-opencontainers" 
PREFERRED_PROVIDER_virtual/kernel = "linux-yocto"
PREFERRED_VERSION_linux-yocto = "4.18%"

PREFERRED_VERSION_keyutils = "1.5.10"
```

## conf/layer.conf
```bitbake
# We have a conf and classes directory, add to BBPATH
BBPATH .= ":${LAYERDIR}"

# We have recipes-* directories, add to BBFILES
BBFILES += "${LAYERDIR}/recipes-*/*/*.bb \
            ${LAYERDIR}/recipes-*/*/*.bbappend"

BBFILE_COLLECTIONS += "starlingX-layer"
BBFILE_PATTERN_starlingX-layer := "^${LAYERDIR}/"
BBFILE_PRIORITY_starlingX-layer = "5"

DISTRO_FEATURES_append = " x11 opengl"
EXTRA_IMAGE_FEATURES_append = " x11-base"
VIRTUAL-RUNTIME_graphical_init_manager = "lxdm"

# INITRAMFS_IMAGE = "secure-core-image-initramfs"
DISTRO_FEATURES_NATIVE_append += "systemd ima tpm tpm2 efi-secure-boot luks"
DISTRO_FEATURES_append += "systemd ima tpm tpm2 efi-secure-boot luks"
#DISTRO_FEATURES_append += "systemd ima tpm tpm2 efi-secure-boot luks modsign"
MACHINE_FEATURES_NATIVE_append += "efi"
MACHINE_FEATURES_append += "efi"
#PACKAGE_CLASSES = "package_rpm"
#INHERIT += "sign_rpm_ext"

#SECURE_CORE_IMAGE_EXTRA_INSTALL ?= "\
#    packagegroup-efi-secure-boot \
#    packagegroup-tpm \
#    packagegroup-tpm2 \
#    packagegroup-ima \
#    packagegroup-luks \
#    "

# For iso image
#KERNEL_FEATURES += "features/overlayfs/overlayfs.scc"

#INITRAMFS_SCRIPTS = "initramfs-live-boot \
#                     initramfs-live-install \
#		     initramfs-live-install-efi \
#		     "

LAYERDEPENDS_starlingX-layer = "\
	core \
	networking-layer \
	openembedded-layer \
	networking-layer \
	filesystems-layer \
	perl-layer \
	meta-python \
	webserver \
	virtualization-layer \
	cloud-services-layer \
	openstack-layer \
	openstack-aio-deploy-layer \
	openstack-compute-deploy-layer \
	openstack-controller-deploy-layer \
	openstack-qemu-layer \
	openstack-swift-deploy-layer \
	signing-key \
	efi-secure-boot \
	encrypted-storage \
	integrity \
	tpm2 \
	secure-core \
	selinux \
"
#	tpm-layer 

#	openstack-compute-test-config-layer 
##	openstack-controller-test-config-layer 

# This should only be incremented on significant changes that will
# cause compatibility issues with other layers
LAYERVERSION_starlingX-version = "1"
LAYERSERIES_COMPAT_starlingX-layer = "thud"

VIRTUAL-RUNTIME_init_manager = "systemd"
DISTRO_FEATURES_append = " systemd"
DISTRO_FEATURES_BACKFILL_CONSIDERED += "sysvinit"

DISTRO_FEATURES_append = " bluez pam largefile opengl"
DISTRO_FEATURES_append = " virtualization"
DISTRO_FEATURES_append = " openstack"
DISTRO_FEATURES_append = " selinux"
DISTRO_FEATURES_append = " kvm"

PREFERRED_PROVIDER_virtual/containerd = "containerd-opencontainers" 
PREFERRED_PROVIDER_virtual/kernel = "linux-yocto"

PREFERRED_VERSION_keyutils = "1.5.10"
```
